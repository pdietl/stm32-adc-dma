## CMakeLists.txt
```
# SPDX-License-Identifier: Apache-2.0

cmake_minimum_required(VERSION 3.13.1)

list(APPEND ZEPHYR_EXTRA_MODULES
  ${CMAKE_CURRENT_SOURCE_DIR}/../../stm32-external-drivers
  )

find_package(Zephyr HINTS $ENV{ZEPHYR_BASE})
project(ATAN)

target_sources(app PRIVATE src/main.c)
```

## prj.conf
```kconfig
# SPDX-License-Identifier: Apache-2.0

CONFIG_STM32_EXTERNAL_DRIVERS=y
CONFIG_EXTERNAL_MATH=y
CONFIG_NEWLIB_LIBC=y
CONFIG_NEWLIB_LIBC_FLOAT_PRINTF=y
CONFIG_FPU=y
```

## src/main.c
```c
/*
 * Copyright (c) 2021 Shlomi Vaknin
 *
 * SPDX-License-Identifier: Apache-2.0
 */

#include <stdio.h>
#include <math/fast_atan.h>

void main(void)
{
	float ret = atan_f32(0.45f);
	printf("atan(0.45) = %f\n", ret);

	ret = atan2_f32(0.24f, 0.213f);
	printf("atan2(0.24, 0.213) = %f\n", ret);
}
```
