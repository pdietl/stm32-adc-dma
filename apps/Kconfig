## apps/Kconfig
```kconfig
# SPDX-License-Identifier: Apache-2.0

menuconfig EXTERNAL_APPS
	bool "External Applications"
	help
	  Enable external applications configuration.

if EXTERNAL_APPS

config ADC_UART
	bool "Enable adc to uart app"
	help
	  Enable adc to uart app. This is used with the async mode,
	  and every half buffer the samples will be sent over uart.

endif # EXTERNAL_APPS
```

## drivers/Kconfig
```kconfig
# SPDX-License-Identifier: Apache-2.0

source "${ZEPHYR_STM32_ADC_DMA_MODULE_DIR}/drivers/adc/Kconfig"

source "${ZEPHYR_STM32_ADC_DMA_MODULE_DIR}/drivers/hwtrig/Kconfig"
```

## drivers/adc/Kconfig
```kconfig
# SPDX-License-Identifier: Apache-2.0

DT_COMPAT_ST_STM32_ADC_DMA := st,stm32-adc-dma

menuconfig EXTERNAL_ADC
	bool "External ADC drivers"
	help
	  Enable external ADC (Analog to Digital Converter) driver configuration.

if EXTERNAL_ADC

config STM32_ADC_DMA
	bool "Enable stm32 adc driver with dma and external trigger"
	default $(dt_compat_enabled,$(DT_COMPAT_ST_STM32_ADC_DMA))
	depends on ADC
	depends on DMA
	select ADC_ASYNC
	help
	  Enable stm32 adc driver with dma and external trigger.

endif # EXTERNAL_ADC
```

## stm32-external-drivers/Kconfig
```kconfig
# SPDX-License-Identifier: Apache-2.0

config STM32_EXTERNAL_DRIVERS
	bool "Enable external stm32 drivers"

if STM32_EXTERNAL_DRIVERS

source "${ZEPHYR_STM32_EXTERNAL_DRIVERS_MODULE_DIR}/drivers/Kconfig"
source "${ZEPHYR_STM32_EXTERNAL_DRIVERS_MODULE_DIR}/apps/Kconfig"

endif # STM32_EXTERNAL_DRIVERS
```

## stm32-external-drivers/apps/Kconfig
```kconfig
# SPDX-License-Identifier: Apache-2.0

config ADC_UART
	bool "Enable adc to uart app"
	help
	  Enable adc to uart app. This is used with the async mode,
	  and every half buffer the samples will be sent over uart.
```

## stm32-external-drivers/drivers/Kconfig
```kconfig
# SPDX-License-Identifier: Apache-2.0

source "${ZEPHYR_STM32_EXTERNAL_DRIVERS_MODULE_DIR}/drivers/adc/Kconfig"

source "${ZEPHYR_STM32_EXTERNAL_DRIVERS_MODULE_DIR}/drivers/dac/Kconfig"

source "${ZEPHYR_STM32_EXTERNAL_DRIVERS_MODULE_DIR}/drivers/hwtrig/Kconfig"
```

## stm32-external-drivers/drivers/adc/Kconfig
```kconfig
# SPDX-License-Identifier: Apache-2.0

DT_COMPAT_ST_STM32_ADC_DMA := st,stm32-adc-dma

config STM32_ADC_DMA
	bool "Enable stm32 adc driver with dma and external trigger"
	default $(dt_compat_enabled,$(DT_COMPAT_ST_STM32_ADC_DMA))
	depends on ADC
	depends on DMA
	select ADC_ASYNC
	help
	  Enable stm32 adc driver with dma and external trigger.
```

## stm32-external-drivers/drivers/dac/Kconfig
```kconfig
# SPDX-License-Identifier: Apache-2.0

DT_COMPAT_ST_STM32_DAC_DMA := st,stm32-dac-dma

menuconfig EXTERNAL_DAC
	bool "External DAC drivers"
	help
	  Enable external DAC (Digital to Analog Converter) driver configuration.

if EXTERNAL_DAC

config STM32_DAC_DMA
	bool "Enable stm32 dac driver with dma and external trigger"
	default $(dt_compat_enabled,$(DT_COMPAT_ST_STM32_DAC_DMA))
	depends on DMA
	help
	  Enable stm32 dac driver with dma and external trigger.

config STM32_DAC_BUFFER_SIZE
	int "stm32 dac buffer size"
	default 8192
	depends on STM32_DAC_DMA
	help
	  stm32 dac driver buffer size.

config DAC_CONTINUOUS_API
	bool "Enable dac countinuous api"
	default y
	depends on STM32_DAC_DMA
	help
	  Enable dac countinuous api.

endif # EXTERNAL_DAC
```

## stm32-external-drivers/drivers/hwtrig/Kconfig
```kconfig
# SPDX-License-Identifier: Apache-2.0

DT_COMPAT_ST_STM32_TIMER_TRIG := st,stm32-timer-trigger

menuconfig HWTRIG
	bool "HWTRIG drivers"
	help
	  Enable hardware trigger driver configuration.

if HWTRIG

config STM32_TIMER_TRIG
	bool "Enable stm32 hardware timer trigger support"
	default $(dt_compat_enabled,$(DT_COMPAT_ST_STM32_TIMER_TRIG))
	select USE_STM32_LL_TIM
	select USE_STM32_LL_RCC if SOC_SERIES_STM32F4X || SOC_SERIES_STM32F7X || SOC_SERIES_STM32H7X
	help
	  Enable stm32 hardware timer trigger support.

endif # HWTRIG
```

## stm32-external-drivers/dts/bindings/adc/st,stm32-adc-dma.yaml
```yaml
# SPDX-License-Identifier: Apache-2.0

description: ST STM32 family ADC

compatible: "st,stm32-adc-dma"

include: adc-controller.yaml

properties:
    reg:
      required: true

    clocks:
      required: true

    st,external-trigger:
      type: int
      required: true
      description: |
        Configures the hardware trigger source of the adc
        controller. See the dt-bindings for relevant values.

    pinctrl-0:
      type: phandles
      required: false
      description: |
        GPIO pin configuration for ADC input. The phandles are
        expected to reference pinctrl nodes, e.g.
           pinctrl-0 = <&adc_in0_pa0 &adc_in1_pa1>;

    interrupts:
      required: true

    "#io-channel-cells":
      const: 1

io-channel-cells:
    - input
```

## stm32-external-drivers/math/Kconfig
```kconfig
# SPDX-License-Identifier: Apache-2.0

menuconfig EXTERNAL_MATH
	bool "External math functions"
	help
	  Enable external math functions configuration.

if EXTERNAL_MATH

config FAST_ATAN
	bool "Enable fast atan and atan2 functions"
	default y
	help
	  Enable fast atan and atan2 functions.

endif # EXTERNAL_MATH
```
